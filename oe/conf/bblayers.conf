## oe/conf/bblayers.conf
```bitbake
# LAYER_CONF_VERSION is increased each time build/conf/bblayers.conf
# changes incompatibly
LCONF_VERSION = "5"
TOPDIR := "${@os.path.dirname(os.path.dirname(d.getVar('FILE', True)))}"

BBPATH = "${TOPDIR}"

BBFILES = ""

# These layers hold recipe metadata not found in OE-core, but lack any machine or distro content
BASELAYERS ?= " \
  ${TOPDIR}/sources/meta-openembedded/meta-oe \
  ${TOPDIR}/sources/meta-openembedded/meta-systemd \
  "

# These layers hold machine specific content, aka Board Support Packages
BSPLAYERS ?= " \
  "

# Add your overlay location to EXTRALAYERS
# Make sure to have a conf/layers.conf in there
EXTRALAYERS ?= ""

BBLAYERS = " \
  ${BASELAYERS} \
  ${BSPLAYERS} \
  ${EXTRALAYERS} \
  ${TOPDIR}/sources/openembedded-core/meta \
  "
```

## oe/conf/local.conf
```bitbake
# CONF_VERSION is increased each time build/conf/ changes incompatibly
CONF_VERSION = "1"

INHERIT += "rm_work devshell"

# Which files do we want to parse:
BBMASK = "meta-gnome|meta-efl|mesa"

# What kind of images do we want?
IMAGE_FSTYPES += "tar.bz2"

DISTRO   = "attolinux-12.x"

# Don't generate the mirror tarball for SCM repos, the snapshot is enough
BB_GENERATE_MIRROR_TARBALLS = "0"

# Disable build time patch resolution. This would lauch a devshell
# and wait for manual intervention. We disable it.
PATCHRESOLVE = "noop"

BB_SCHEDULER = "speed"

FETCHCMD_wget = "/usr/bin/env wget -t 2 -T 30 -nv --no-passive-ftp --no-check-certificate"
#INCOMPATIBLE_LICENSE = "GPLv3"
#HOSTTOOLS_WHITELIST_GPLv3 = "*"
```
